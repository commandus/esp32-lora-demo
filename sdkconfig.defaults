## sdkconfig.defaults
```kconfig
#
# BT config
#
CONFIG_BT_ENABLED=y
CONFIG_BTDM_CTRL_MODE_BLE_ONLY=y
CONFIG_BTDM_CTRL_MODE_BR_EDR_ONLY=n
CONFIG_BTDM_CTRL_MODE_BTDM=n

#
# ESP32-specific config
#
CONFIG_ESP32_ENABLE_STACK_BT=y
# CONFIG_ESP32_ENABLE_STACK_NONE is not set
CONFIG_MEMMAP_BT=y

#
# LMIC
#
CONFIG_LMIC_DEBUG_LEVEL=2

CONFIG_LMIC_FREQ_USE_EU_868=y
# CONFIG_LMIC_FREQ_USE_US_915=n

CONFIG_LMIC_USE_SX1276=y
# CONFIG_LMIC_USE_SX1272=n

# CONFIG_LMIC_SPI_HSPI
# CONFIG_LMIC_SPI_VSPI

CONFIG_LMIC_FEATURE_BEACONS=y
CONFIG_LMIC_FEATURE_PING=y
CONFIG_LMIC_FEATURE_JOIN=y
CONFIG_ESP32_RTC_CLK_SRC="Internal 150kHz oscillator"
```
